&trackball_central {
    cpi = <600>;
};
&trackball_central_listener {
    status = "okay";
    device = <&trackball_central>;
    input-processors = <&zip_ble_report_rate_limit>;
};
&trackball_peripheral_listener {
    status = "okay";
    input-processors = <&zip_ble_report_rate_limit>;
};
